; --- TRACE32 Basic Load Script (Refined & Proven Sequence) ---
WinCLEAR
SYStem.RESet
SYStem.CPU TC364DP
SYStem.Up

IF !SYStem.Up()
(
   PRINT "FAIL: 보드 연결 실패"
   ENDDO
)

; 1. Flash 프로그래밍 준비 (기존 test_stm.cmm 성공 케이스 참조)
DO "C:\T32\demo\tricore\flash\tc36x.cmm" CPU=TC364DP PREPAREONLY
FLASH.ReProgram ALL /Erase

; 2. ELF File Download
Data.LOAD.Elf "C:\Users\swyoon\Desktop\MCAL TEST\TC364L_AS422_2_40_0_Init\Debug\TC364L_AS422_2_40_0_Init.elf"
FLASH.ReProgram OFF

; 3. Open Windows (List, System State, and Watch)
; 3. Open Windows (Layout provided by USER)
WinPOS 0. 0. 90. 24. 0. 0. W000
List.auto
WinPOS 100. 0. 52. 16. 0. 0. W001
SYStem.state
WinPOS 0. 30. 62. 13. 0. 0. W002
Var.Watch SPI_Command

; 4. Move to core0_main function
Break.RESet
Break.Set core0_main /Program
Go core0_main
WAIT !STATE.RUN() 2.s

PRINT "core0_main() reached. Debugging ready!"
ENDDO
